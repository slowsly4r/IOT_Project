#include "tinyml.h"

namespace {
// TINYML RUNTIME CONTEXT
// Stores TensorFlow Lite interpreter state (persistent across invocations)
struct TinyMlRuntimeContext {
    tflite::ErrorReporter *errorReporter;
    const tflite::Model *model;
    tflite::MicroInterpreter *interpreter;
    TfLiteTensor *input;
    TfLiteTensor *output;
    // Tensor arena: 8KB RAM reserved for TFLite operations
    static constexpr int kTensorArenaSize = 8 * 1024;
    uint8_t tensorArena[kTensorArenaSize];

    TinyMlRuntimeContext()
        : errorReporter(nullptr), model(nullptr), interpreter(nullptr),
          input(nullptr), output(nullptr), tensorArena{0} {}
};

TinyMlRuntimeContext& getTinyCtx() {
    static TinyMlRuntimeContext ctx;
    return ctx;
}
}

// ============================================================================
// TASK 5: TINYML INFERENCE FOR ANOMALY DETECTION (Consumer)
// Loads TFLite model and performs inference on temperature/humidity data
// Model predicts anomaly when: temp > 35°C OR humidity > 80%
// ============================================================================

void setupTinyML()
{
    TinyMlRuntimeContext &ctx = getTinyCtx();

    Serial.println("TensorFlow Lite Init....");
    static tflite::MicroErrorReporter microErrorReporter;
    ctx.errorReporter = &microErrorReporter;

    // Load TFLite model from header file (generated by TFL_For_MCU.py)
    ctx.model = tflite::GetModel(dht_anomaly_model_tflite);
    if (ctx.model->version() != TFLITE_SCHEMA_VERSION)
    {
        ctx.errorReporter->Report("Model provided is schema version %d, not equal to supported version %d.",
                               ctx.model->version(), TFLITE_SCHEMA_VERSION);
        return;
    }

    // Initialize TFLite interpreter with all available operations
    static tflite::AllOpsResolver resolver;
    static tflite::MicroInterpreter staticInterpreter(
        ctx.model, resolver, ctx.tensorArena,
        TinyMlRuntimeContext::kTensorArenaSize, ctx.errorReporter);
    ctx.interpreter = &staticInterpreter;

    // Allocate tensors in memory
    TfLiteStatus allocateStatus = ctx.interpreter->AllocateTensors();
    if (allocateStatus != kTfLiteOk)
    {
        ctx.errorReporter->Report("AllocateTensors() failed");
        return;
    }

    // Get input/output tensor pointers
    ctx.input = ctx.interpreter->input(0);
    ctx.output = ctx.interpreter->output(0);

    Serial.println("TensorFlow Lite Micro initialized on ESP32.");
}

// ============================================================================
// TINYML FREERTOS TASK
// Reads sensor data, runs inference, publishes prediction to shared data
// ============================================================================
void tiny_ml_task(void *pvParameters)
{
    TinyMlRuntimeContext &ctx = getTinyCtx();
    SystemData_t *pData = (SystemData_t *)pvParameters;

    setupTinyML();

    while (1) {
        // Wait for signal from sensor task that new data is available
        if (xSemaphoreTake(pData->xTinyMLReady, pdMS_TO_TICKS(5000)) == pdTRUE) {
            float t = 0, h = 0;
            // Read shared sensor data (mutex protected)
            if (xSemaphoreTake(pData->xDataMutex, portMAX_DELAY)) {
                t = pData->temperature;
                h = pData->humidity;
                xSemaphoreGive(pData->xDataMutex);
            }

            // Skip if interpreter not initialized
            if (ctx.input == nullptr || ctx.output == nullptr || ctx.interpreter == nullptr) {
                vTaskDelay(pdMS_TO_TICKS(100));
                continue;
            }

            // Set model input: [temperature, humidity]
            ctx.input->data.f[0] = t;
            ctx.input->data.f[1] = h;

            // Run inference
            if (ctx.interpreter->Invoke() != kTfLiteOk) {
                if (ctx.errorReporter != nullptr) {
                    ctx.errorReporter->Report("Invoke failed");
                }
            } else {
                // Get prediction score (0 = normal, 1 = anomaly)
                float score = ctx.output->data.f[0];
                // Threshold 0.6 optimized for best F1-score
                int prediction = (score > 0.6f) ? 1 : 0;

                // Store prediction in shared data (mutex protected)
                if (xSemaphoreTake(pData->xDataMutex, portMAX_DELAY)) {
                    pData->ai_prediction = prediction;
                    xSemaphoreGive(pData->xDataMutex);
                }

                // Log anomaly alerts
                if (prediction == 1) {
                    Serial.printf("AI ALERT: Anomaly Detected (Score: %.2f)\n", score);
                }
            }
        }
        vTaskDelay(pdMS_TO_TICKS(100));
    }
}